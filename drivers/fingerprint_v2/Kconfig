## drivers/fingerprint_v2/Kconfig
```kconfig
#
# Sensor  drivers configuration
#
menuconfig SENSORS_FINGERPRINT_V2
	tristate "Finger Print Sensor devices"
	help
	  Say Y here, and a list of sensors drivers will be displayed.
	  Everything that didn't fit into the other categories is here. This option
	  doesn't affect the kernel.
	  If unsure, say Y.

config FINGERPRINT_SECURE
	tristate "fingerprint sensor support"
	default n
	help
	  If you say yes here you get support for Trustzone.

config SENSORS_FPRINT_SECURE
	tristate "fingerprint sensor support"
	default n
	help
	  If you say yes here you get support for Trustzone.
	  In case of user binary, fingerprint sensor operates within trustzone.
	  If this feature enabled, spi communication is controlled by Trusted Application.
	  Then it should be enabled in the user binary.

config SENSORS_FINGERPRINT_MODULE
	bool "module build"
	default n
	help
	  You choose yes if you are using module build on fingerprint.

config SENSORS_FINGERPRINT_LSI
	tristate "System LSI AP support"
	default n
	help
	  If you say yes here you get support for System LSI AP.

config SENSORS_FINGERPRINT_QCOM
	tristate "Qualcomm AP support"
	default n
	help
	  If you say yes here you get support for Qualcomm AP.

config SENSORS_FINGERPRINT_MTK
	tristate "Mediatek AP support"
	default n
	help
	  If you say yes here you get support for Mediatek AP.

config SENSORS_FINGERPRINT_NORMALSPI
	tristate "Goodix SPI normal mode"
	default n
	help
	  If you say yes here you get to use spi normal mode on goodix sensor.

config SENSORS_FINGERPRINT_32BITS_PLATFORM_ONLY
	tristate "32bits platform support"
	default n
	help
	  If you say yes here you get support for 32bits platform.

config SENSORS_GW9558X
	tristate "generic goodix fingerprint driver"
	default n
	help
	  If you say yes here you get support for Goodix's
	  fingerprint sensor GW9558X.
```
